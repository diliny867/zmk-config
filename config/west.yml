## config/west.yml
```yaml
manifest:
  defaults:
    revision: main
  remotes:
    - name: zmkfirmware
      url-base: https://github.com/zmkfirmware
    - name: urob
      url-base: https://github.com/urob
  projects:
    - name: zmk
      remote: urob
      revision: v0.2.1
      import: app/west.yml
    - name: zmk-helpers
      remote: urob
    - name: zmk-auto-layer
      remote: urob
    - name: zmk-tri-state
      remote: urob
    - name: zmk-leader-key
      remote: urob
  self:
    path: config
```
