
#define QUICK_TAP_MS 150

&mt {
    tapping-term-ms = <QUICK_TAP_MS>;
};

&lt {
    flavor = "balanced";
    tapping-term-ms = <200>;
    quick-tap-ms = <QUICK_TAP_MS>;
};


&mmv {
    x-input-code = <INPUT_REL_X>;
    y-input-code = <INPUT_REL_Y>;
    time-to-max-speed-ms = <220>;
    trigger-period-ms = <12>;
    acceleration-exponent = <1>;
};
&msc {
    x-input-code = <INPUT_REL_HWHEEL>;
    y-input-code = <INPUT_REL_WHEEL>;
    time-to-max-speed-ms = <220>;
    trigger-period-ms = <12>;
    acceleration-exponent = <0>;
};